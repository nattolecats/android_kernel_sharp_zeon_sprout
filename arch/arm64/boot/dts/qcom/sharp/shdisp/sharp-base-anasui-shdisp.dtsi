/* Copyright (c) 2017, The Linux Foundation. All rights reserved.
 *
 * This program is free software; you can redistribute it and/or modify
 * it under the terms of the GNU General Public License version 2 and
 * only version 2 as published by the Free Software Foundation.
 *
 * This program is distributed in the hope that it will be useful,
 * but WITHOUT ANY WARRANTY; without even the implied warranty of
 * MERCHANTABILITY or FITNESS FOR A PARTICULAR PURPOSE.  See the
 * GNU General Public License for more details.
 */

/*****************************************/
/* Delete Qualcomm node/property         */
/*****************************************/
&mdss_dsi0 {
	/delete-property/ vdda-3p3-supply;

	/delete-property/qcom,platform-enable-gpio;

	/delete-property/ vdd-supply;
	/delete-property/ vddio-supply;
};

&mdss_dsi0_pll {
	/delete-property/ qcom,dsi-pll-ssc-en;
	/delete-property/ qcom,dsi-pll-ssc-mode;
};

&soc {
	/delete-node/ mdss_hdmi_tx;
};
