/*
 * Copyright (c) 2017-2018, The Linux Foundation. All rights reserved.
 *
 * This program is free software; you can redistribute it and/or modify
 * it under the terms of the GNU General Public License version 2 and
 * only version 2 as published by the Free Software Foundation.
 *
 * This program is distributed in the hope that it will be useful,
 * but WITHOUT ANY WARRANTY; without even the implied warranty of
 * MERCHANTABILITY or FITNESS FOR A PARTICULAR PURPOSE.  See the
 * GNU General Public License for more details.
 */
/*****************************************/
/*  Add SHARP include                    */
/*****************************************/
//#include "sharp-chg-param-pmi632-anasui.dtsi"

/*****************************************/
/*  pmi632-gpios: qpnp-pin               */
/*****************************************/
&pmi632_gpios {
	compatible = "qcom,spmi-gpio";
	reg = <0xc000 0x800>;
	interrupts = <0x2 0xc0 0 IRQ_TYPE_NONE>,
			<0x2 0xc1 0 IRQ_TYPE_NONE>,
			<0x2 0xc2 0 IRQ_TYPE_NONE>,
			<0x2 0xc3 0 IRQ_TYPE_NONE>,
//			<0x2 0xc4 0 IRQ_TYPE_NONE>,
			<0x2 0xc5 0 IRQ_TYPE_NONE>,
			<0x2 0xc6 0 IRQ_TYPE_NONE>,
			<0x2 0xc7 0 IRQ_TYPE_NONE>;
	interrupt-names = "pmi632_gpio1",
					"pmi632_gpio2",
					"pmi632_gpio3",
					"pmi632_gpio4",
//					"pmi632_gpio5",
					"pmi632_gpio6",
					"pmi632_gpio7",
					"pmi632_gpio8";

	gpio-controller;
	#gpio-cells = <2>;
	qcom,gpios-disallowed = <5>;
};

/*****************************************/
/* batterydata */
/*****************************************/
&mtp_batterydata {
	qcom,batt-id-range-pct = <15>;
	#include "qg-batterydata-sharp-e2-2700mah.dtsi"
};

/*****************************************/
/* pmi632_qg */
/*****************************************/

/*****************************************/
/*  qpnp-adc-voltage                     */
/*****************************************/

/*****************************************/
/*  qpnp-vadc-tm                         */
/*****************************************/

/*****************************************/
/*  thermal_zones                        */
/*****************************************/
