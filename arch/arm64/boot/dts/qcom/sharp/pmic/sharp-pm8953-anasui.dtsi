/*
 * Copyright (c) 2017-2018, The Linux Foundation. All rights reserved.
 *
 * This program is free software; you can redistribute it and/or modify
 * it under the terms of the GNU General Public License version 2 and
 * only version 2 as published by the Free Software Foundation.
 *
 * This program is distributed in the hope that it will be useful,
 * but WITHOUT ANY WARRANTY; without even the implied warranty of
 * MERCHANTABILITY or FITNESS FOR A PARTICULAR PURPOSE.  See the
 * GNU General Public License for more details.
 */
/*****************************************/
/*  Add SHARP include                    */
/*****************************************/

/*****************************************/
/*  pm8953: qcom,pm8953 alias            */
/*****************************************/

/*****************************************/
/*  pm8953-gpios: qpnp-pin               */
/*****************************************/
&pm8953_gpios {
	compatible = "qcom,spmi-gpio";
	reg = <0xc000 0x800>;

	interrupts = <0x0 0xc0 0 IRQ_TYPE_NONE>,
		<0x0 0xc1 0 IRQ_TYPE_NONE>,
//		<0x0 0xc2 0 IRQ_TYPE_NONE>,
		<0x0 0xc3 0 IRQ_TYPE_NONE>,
		<0x0 0xc4 0 IRQ_TYPE_NONE>,
		<0x0 0xc5 0 IRQ_TYPE_NONE>,
		<0x0 0xc6 0 IRQ_TYPE_NONE>,
		<0x0 0xc7 0 IRQ_TYPE_NONE>;
	interrupt-names = "pm8953_gpio1",
					"pm8953_gpio2",
//					"pm8953_gpio3",
					"pm8953_gpio4",
					"pm8953_gpio5",
					"pm8953_gpio6",
					"pm8953_gpio7",
					"pm8953_gpio8";

	gpio-controller;
	#gpio-cells = <2>;
	qcom,gpios-disallowed = <3>;
};

&pm8953_mpps {
	compatible = "qcom,spmi-mpp";
	reg = <0xa000 0x400>;

	interrupts = <0x0 0xa1 0 IRQ_TYPE_NONE>,
		<0x0 0xa3 0 IRQ_TYPE_NONE>;
	interrupt-names = "pm8953_mpp2",
					"pm8953_mpp4";

	gpio-controller;
	#gpio-cells = <2>;
	qcom,gpios-disallowed = <1 3>;
};

/*****************************************/
/*  pm8953-mpps: qpnp-pin                */
/*****************************************/

/*****************************************/
/*  pm8953: rpm-regulator                */
/*****************************************/

/*****************************************/
/*  qpnp-adc-voltage                     */
/*****************************************/

/*****************************************/
/*  qpnp-vadc-tm                         */
/*****************************************/

/*****************************************/
/*  thermal_zones                        */
/*****************************************/

/*****************************************/
/*  SHARP Device Drivers                 */
/*****************************************/

