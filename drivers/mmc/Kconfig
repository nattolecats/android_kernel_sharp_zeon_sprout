## drivers/mmc/Kconfig
```kconfig
#
# MMC subsystem configuration
#

menuconfig MMC
	tristate "MMC/SD/SDIO card support"
	depends on HAS_IOMEM
	help
	  This selects MultiMediaCard, Secure Digital and Secure
	  Digital I/O support.

	  If you want MMC/SD/SDIO support, you should say Y here and
	  also to your specific host controller driver.

config MMC_DEBUG
	bool "MMC debugging"
	depends on MMC != n
	help
	  This is an option for use by developers; most people should
	  say N here.  This enables MMC core and driver debugging.

config MMC_PERF_PROFILING
	bool "MMC performance profiling"
	depends on MMC != n
	default n
	help
	  If you say Y here, support will be added for collecting
	  performance numbers at the MMC Queue and Host layers.

config SHARP_MMC
	bool "SHARP MMC driver customized"
	depends on MMC
	default n

config SHARP_MMC_EMMC
	bool "SHARP eMMC driver customized"
	depends on SHARP_MMC
	default n

config SHARP_MMC_EMMC_DRIVESTRENGTH
	bool "SHARP eMMC driver customized for drive strength"
	depends on SHARP_MMC_EMMC
	default n

config SHARP_MMC_EMMC_TIMEOUTCTRL
	bool "SHARP eMMC driver customized for timeout control"
	depends on SHARP_MMC_EMMC
	default n

config SHARP_MMC_EMMC_CLKGATE_TIME
	bool "SHARP eMMC driver customized for clkgate time"
	depends on SHARP_MMC_EMMC
	default n

config SHARP_MMC_EMMC_DISCARD
	bool "SHARP eMMC driver customized for discard"
	depends on SHARP_MMC_EMMC
	default n

config SHARP_MMC_EMMC_CACHE_DISABLE
	bool "SHARP eMMC driver customized for cache disable"
	depends on SHARP_MMC_EMMC
	default n

config SHARP_MMC_EMMC_FFU
	bool "SHARP eMMC driver customized for ffu"
	depends on SHARP_MMC_EMMC
	default n

config SHARP_MMC_EMMC_ERR_RETRY
	bool "SHARP eMMC driver customized for error retry"
	depends on SHARP_MMC_EMMC
	default n

config SHARP_MMC_EMMC_ERR_DETECT
	bool "SHARP eMMC driver customized for error detect"
	depends on SHARP_MMC_EMMC
	default n

config SHARP_MMC_SD
	bool "SHARP SD driver customized"
	depends on SHARP_MMC
	default n

config SHARP_MMC_SD_DISABLE_CLK_SCALE
	bool "SHARP SD driver customized for disable Clock Scaling"
	depends on SHARP_MMC_SD
	default n

config SHARP_MMC_SD_ENABLE_ONLY_DDR50
	bool "SHARP SD driver customized for enable DDR50 mode"
	depends on SHARP_MMC_SD
	default n

config SHARP_MMC_SD_BATTLOG
	bool "SHARP SD driver customized for logging"
	depends on SHARP_MMC_SD
	default n

if MMC

source "drivers/mmc/core/Kconfig"

source "drivers/mmc/card/Kconfig"

source "drivers/mmc/host/Kconfig"

endif # MMC
```

## drivers/nfc/cxd225x/Kconfig
```kconfig
#
# Near Field Communication (NFC) devices
#

menu "CXD225X NFC Chip Driver Support"

config NFC_CXD225X
	tristate "CXD225X NFC driver"

	depends on I2C
	select CRC_CCITT
	default n
	---help---
	  Say yes if you want cxd225x Near Field Communication driver.
	  This is for i2c connected version. If unsure, say N here.

	  To compile this driver as a module, choose m here. The module will
	  be called cxd225x-i2c.

config NFC_CXD225X_PROBE_RST
	bool "CXD225X PROBE RST"
	default n

config NFC_CXD225X_RST_USE_PMIC
	bool "CXD225X RST USE PMIC"
	default n

endmenu
```
