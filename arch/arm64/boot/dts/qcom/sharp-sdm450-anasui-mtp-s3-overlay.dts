/*
 * Copyright (c) 2018, The Linux Foundation. All rights reserved.
 *
 * This program is free software; you can redistribute it and/or modify
 * it under the terms of the GNU General Public License version 2 and
 * only version 2 as published by the Free Software Foundation.
 *
 * This program is distributed in the hope that it will be useful,
 * but WITHOUT ANY WARRANTY; without even the implied warranty of
 * MERCHANTABILITY or FITNESS FOR A PARTICULAR PURPOSE.  See the
 * GNU General Public License for more details.
 */

/dts-v1/;
/plugin/;

#include "sdm450-pmi632-mtp-s3.dtsi"

/ {
	model = "sharp anasui. MTP S3";
	compatible = "qcom,sharp-anasui", "qcom,sdm450";
	qcom,board-id = <40 0>;
	qcom,pmic-id = <0x010016 0x10025 0x0 0x0>;
};

/*****************************************/
/*  Add SHARP include                    */
/*****************************************/
#include <dt-bindings/interrupt-controller/irq.h>
#include "sharp/sharp-sdm450.dtsi"
#include "sharp/sharp-anasui.dtsi"

